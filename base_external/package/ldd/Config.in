## base_external/package/ldd/Config.in
```kconfig
config BR2_PACKAGE_LDD
	bool "ldd"
	help
	  Includes the .ko compiled from for scull driver in the kernel.
	  Used to understand buildroot external trees and package builds.
```
